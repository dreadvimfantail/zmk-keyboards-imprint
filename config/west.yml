## config/west.yml
```yaml
manifest:
  remotes:
    - name: Cyboard-DigitalTailor
      url-base: https://github.com/Cyboard-DigitalTailor
  projects:
    - name: zmk-pmw3610-driver
      remote: Cyboard-DigitalTailor
      revision: startup_optimization
```
